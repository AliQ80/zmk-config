## boards/shields/reviung41_dongle/Kconfig.defconfig
```kconfig
if SHIELD_REVIUNG41_DONGLE

config ZMK_KEYBOARD_NAME
    default "Reviung41"

config ZMK_SPLIT
    default y

config ZMK_SPLIT_ROLE_CENTRAL
    default y

# Single unibody peripheral (ZMK default is already 1, set explicitly for clarity)
config ZMK_SPLIT_BLE_CENTRAL_PERIPHERALS
    default 1

# 1 peripheral + 5 BT profiles = 6 total connections
config BT_MAX_CONN
    default 6

config BT_MAX_PAIRED
    default 6

endif
```

## boards/shields/reviung41_dongle/Kconfig.shield
```kconfig
config SHIELD_REVIUNG41_DONGLE
    def_bool $(shields_list_contains,reviung41_dongle)
```

## config/west.yml
```yaml
manifest:
  defaults:
    revision: main
  remotes:
    - name: zmkfirmware
      url-base: https://github.com/zmkfirmware
    - name: carrefinho
      url-base: https://github.com/carrefinho
  projects:
    - name: zmk
      remote: zmkfirmware
      import: app/west.yml
    - name: prospector-zmk-module
      remote: carrefinho
      revision: feat/new-status-screens
      import: false
  self:
    path: config
```
